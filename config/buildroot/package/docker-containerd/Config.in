## config/buildroot/package/docker-containerd/Config.in
```kconfig
config BR2_PACKAGE_DOCKER_CONTAINERD
	bool "docker-containerd"
	depends on BR2_PACKAGE_HOST_GO_ARCH_SUPPORTS
	depends on BR2_PACKAGE_HOST_GO_CGO_LINKING_SUPPORTS
	depends on BR2_TOOLCHAIN_HAS_THREADS
	select BR2_PACKAGE_RUNC # runtime dependency
	help
	  containerd is a daemon to control runC.

	  https://github.com/docker/containerd

comment "docker-containerd needs a toolchain w/ threads, wchar"
	depends on BR2_PACKAGE_HOST_GO_ARCH_SUPPORTS
	depends on BR2_PACKAGE_HOST_GO_CGO_LINKING_SUPPORTS
	depends on !BR2_TOOLCHAIN_HAS_THREADS || !BR2_USE_WCHAR
```
